//#include "ssd1306.h"
#include "Board.h"
static uint8_t buffer[SSD1306_LCDHEIGHT * SSD1306_LCDWIDTH / 8] = {
	0x00, 0x00, 0x00, 0x00, 0x00, 0x00, 0x00, 0x00, 0x00, 0x00, 0x00, 0x00, 0x00, 0x00, 0x00, 0x00,
	0x00, 0x00, 0x00, 0x00, 0x00, 0x00, 0x00, 0x00, 0x00, 0x00, 0x00, 0x00, 0x00, 0x00, 0x00, 0x00,
	0x00, 0x00, 0x00, 0x00, 0x00, 0x00, 0x00, 0x00, 0x00, 0x00, 0x00, 0x00, 0x00, 0x00, 0x00, 0x00,
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	0x00, 0x00, 0x00, 0x00, 0x00, 0x00, 0x00, 0x00, 0x00, 0x00, 0x00, 0x00, 0x00, 0x00, 0x00, 0x00
};



#define ssd1306_swap(a, b) { int16_t t = a; a = b; b = t; }

void ssd1306_command(uint8_t command) {
	HAL_I2C_Mem_Write(&hi2c2, _i2caddr, 0x00, 1, &command, 1, 10);
}

void ssd1306_begin(uint8_t vccstate, uint8_t i2caddr) {
	HAL_Delay(100);
	_vccstate = vccstate;
	_i2caddr = i2caddr<<1;
	_width   = SSD1306_LCDWIDTH;
	_height  = SSD1306_LCDHEIGHT;

	// Init sequence
	ssd1306_command(SSD1306_DISPLAYOFF);                    // 0xAE
	//ssd1306_command(SSD1306_SETDISPLAYCLOCKDIV);            // 0xD5
	//ssd1306_command(0x80);                                  // the suggested ratio 0x80
	ssd1306_command(SSD1306_SETMULTIPLEX);                  // 0xA8
	ssd1306_command(SSD1306_LCDHEIGHT - 1);
	ssd1306_command(SSD1306_SETDISPLAYOFFSET);              // 0xD3
	ssd1306_command(0x0);                                   // no offset
	ssd1306_command(SSD1306_SETSTARTLINE | 0x0);            // line #0
	ssd1306_command(SSD1306_CHARGEPUMP);                    // 0x8D
	if (vccstate == SSD1306_EXTERNALVCC) { ssd1306_command(0x10); }
	else { ssd1306_command(0x14); }
	ssd1306_command(SSD1306_MEMORYMODE);                    // 0x20
	ssd1306_command(0x00);                                  // 0x0 act like ks0108
	ssd1306_command(SSD1306_SEGREMAP | 0x1);
	ssd1306_command(SSD1306_COMSCANDEC);
	ssd1306_command(SSD1306_SETCOMPINS);                    // 0xDA
	ssd1306_command(0x12);
	if (vccstate == SSD1306_EXTERNALVCC) { ssd1306_command(0x9F); }
	else { ssd1306_command(0xCF); }
	ssd1306_command(SSD1306_SETPRECHARGE);                  // 0xd9
	if (vccstate == SSD1306_EXTERNALVCC) { ssd1306_command(0x22); }
	else { ssd1306_command(0xF1); }
	ssd1306_command(SSD1306_SETVCOMDETECT);                 // 0xDB
	ssd1306_command(0x40);
	ssd1306_command(SSD1306_DISPLAYALLON_RESUME);           // 0xA4
	ssd1306_command(SSD1306_NORMALDISPLAY);                 // 0xA6

	ssd1306_command(SSD1306_DEACTIVATE_SCROLL);

	ssd1306_command(SSD1306_DISPLAYON);//--turn on oled panel
}

void display(void) {
	for (uint8_t i = 0; i < 8; i++) {
		ssd1306_command(0xB0 + i); // Set Page Start Address for Page Addressing Mode (B0h~B7h)
		ssd1306_command(SSD1306_SETLOWCOLUMN);
		ssd1306_command(SSD1306_SETHIGHCOLUMN);

		HAL_I2C_Mem_Write(&hi2c2, _i2caddr, SSD1306_SETSTARTLINE, 1, &buffer[SSD1306_LCDWIDTH * i], SSD1306_LCDWIDTH, 100);
		//HAL_I2C_Mem_Write(&hi2c2, _i2caddr, SSD1306_SETSTARTLINE, 1, buffer, 1024, 100);
		//HAL_I2C_Mem_Write_DMA(&hi2c2, _i2caddr, SSD1306_SETSTARTLINE, 1, &buffer[SSD1306_LCDWIDTH * i], SSD1306_LCDWIDTH);
	}
}
/*
void display(void) {
	ssd1306_command(0xB0); // Set Page Start Address for Page Addressing Mode (B0h~B7h)
	ssd1306_command(SSD1306_SETLOWCOLUMN);
	ssd1306_command(SSD1306_SETHIGHCOLUMN);

	HAL_I2C_Mem_Write_DMA(&hi2c2, _i2caddr, SSD1306_SETSTARTLINE, 1, buffer, 1024);
}
*/
void clearDisplay(void) {
	memset(buffer, 0, (SSD1306_LCDWIDTH*SSD1306_LCDHEIGHT/8));
	display();
}

void drawPixel(uint8_t x, uint8_t y, uint8_t color) {
	if (x >= SSD1306_LCDWIDTH || y >= SSD1306_LCDHEIGHT) return;

	//if (SSD1306.Inverted) color = (SSD1306_COLOR)!color;

	if (color == WHITE) buffer[x + (y / 8) * SSD1306_LCDWIDTH] |= 1 << (y % 8);
	else                buffer[x + (y / 8) * SSD1306_LCDWIDTH] &= ~(1 << (y % 8));
}

void invertDisplay(uint8_t i) {
	if (i) ssd1306_command(SSD1306_INVERTDISPLAY);
	else   ssd1306_command(SSD1306_NORMALDISPLAY);
}

void startscrollright(uint8_t start, uint8_t stop) {
	ssd1306_command(SSD1306_RIGHT_HORIZONTAL_SCROLL);
	ssd1306_command(0X00);
	ssd1306_command(start);
	ssd1306_command(0X00);
	ssd1306_command(stop);
	ssd1306_command(0X00);
	ssd1306_command(0XFF);
	ssd1306_command(SSD1306_ACTIVATE_SCROLL);
}

void startscrollleft(uint8_t start, uint8_t stop) {
	ssd1306_command(SSD1306_LEFT_HORIZONTAL_SCROLL);
	ssd1306_command(0X00);
	ssd1306_command(start);
	ssd1306_command(0X00);
	ssd1306_command(stop);
	ssd1306_command(0X00);
	ssd1306_command(0XFF);
	ssd1306_command(SSD1306_ACTIVATE_SCROLL);
}

void startscrolldiagright(uint8_t start, uint8_t stop) {
	ssd1306_command(SSD1306_SET_VERTICAL_SCROLL_AREA);
	ssd1306_command(0X00);
	ssd1306_command(SSD1306_LCDHEIGHT);
	ssd1306_command(SSD1306_VERTICAL_AND_RIGHT_HORIZONTAL_SCROLL);
	ssd1306_command(0X00);
	ssd1306_command(start);
	ssd1306_command(0X00);
	ssd1306_command(stop);
	ssd1306_command(0X01);
	ssd1306_command(SSD1306_ACTIVATE_SCROLL);
}

void startscrolldiagleft(uint8_t start, uint8_t stop) {
	ssd1306_command(SSD1306_SET_VERTICAL_SCROLL_AREA);
	ssd1306_command(0X00);
	ssd1306_command(SSD1306_LCDHEIGHT);
	ssd1306_command(SSD1306_VERTICAL_AND_LEFT_HORIZONTAL_SCROLL);
	ssd1306_command(0X00);
	ssd1306_command(start);
	ssd1306_command(0X00);
	ssd1306_command(stop);
	ssd1306_command(0X01);
	ssd1306_command(SSD1306_ACTIVATE_SCROLL);
}

void stopscroll(void) {
  ssd1306_command(SSD1306_DEACTIVATE_SCROLL);
}

void dim(uint8_t dim) {
	uint8_t contrast;

	if(dim==SET) contrast = 0; // Dimmed display
	else {
		if(_vccstate == SSD1306_EXTERNALVCC) contrast = 0x9F;
		else 								 contrast = 0xCF;
	}
	// the range of contrast to too small to be really useful
	// it is useful to dim the display
	ssd1306_command(SSD1306_SETCONTRAST);
	ssd1306_command(contrast);
}

void OLed_printf(int x, int y,  const char *fmt, ...)
{
  int32_t ret = 0;
  va_list arg;
  va_start (arg, fmt);
  int32_t len;
  char print_buffer[256];
  int Str_Size;
  int Size_Char;
  int i, x_Pre = x;
  PHAN_FONT_OBJ FontBuf;



  len = vsnprintf(print_buffer, 255, fmt, arg);
  va_end (arg);
  //HAL_UART_Transmit(&huart1, (uint8_t*)print_buffer, strlen(print_buffer), 1000);
  for( i=0; i<len; i+=Size_Char )
  {
    PHan_FontLoad( &print_buffer[i], &FontBuf );


    disHanFont( x, y, &FontBuf );

    Size_Char = FontBuf.Size_Char;
    if (Size_Char >= 2)
    {
        x += 2*8;
    }
    else
    {
        x += 1*8;
    }

    if( 128 < x )
    {
        x  = x_Pre;
        y += 16;
    }

    if( FontBuf.Code_Type == PHAN_END_CODE ) break;
  }
}

void disHanFont(int x, int y, PHAN_FONT_OBJ *FontPtr)
{
  uint16_t    i, j, Loop;
  uint16_t  FontSize = FontPtr->Size_Char;
  uint16_t index_x;

  if (FontSize > 2)
  {
    FontSize = 2;
  }

  for ( i = 0 ; i < 16 ; i++ )        // 16 Lines per Font/Char
  {
    index_x = 0;
    for ( j = 0 ; j < FontSize ; j++ )      // 16 x 16 (2 Bytes)
    {
      for( Loop=0; Loop<8; Loop++ )
      {
        if( FontPtr->FontBuffer[i*FontSize +j] & (0x80>>Loop))
        {
          drawPixel(x + index_x++, y + i, WHITE);
        }
        else
        {
          drawPixel(x + index_x++, y + i, BLACK);
        }
      }
    }
  }
}



